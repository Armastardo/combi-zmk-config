## boards/arm/combi/Kconfig.board
```kconfig
# Copyright (c) 2022 Brandon Beltran
# SPDX-License-Identifier: MIT

config BOARD_COMBI
	bool "combi"
	depends on SOC_NRF52840_QIAA
```

## boards/arm/combi/Kconfig.defconfig
```kconfig
# Copyright (c) 2022 Brandon Beltran
# SPDX-License-Identifier: MIT

if BOARD_COMBI

config ZMK_KEYBOARD_NAME
	default "COMBI"

if USB_DEVICE_STACK

config USB_NRFX
	default y

endif # USB_DEVICE_STACK

config BT_CTLR
	default BT

endif # BOARD_COMBI
```
